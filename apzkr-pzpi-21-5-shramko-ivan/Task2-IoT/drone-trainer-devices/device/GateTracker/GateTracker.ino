#include <cstdlib>
#include <stdbool.h>
#include <string.h>
#include <time.h>
#include <MFRC522.h>
#include <ESP8266WiFi.h>
#include <PubSubClient.h>
#include <WiFiClientSecure.h>
#include <base64.h>
#include <bearssl/bearssl.h>
#include <bearssl/bearssl_hmac.h>
#include <libb64/cdecode.h>
#include <az_core.h>
#include <az_iot.h>
#include <Arduino.h>
#include <EEPROM.h>
#include <ArduinoJson.h>
#include <vector>
#include <ctime>
#include <SPI.h>

#define AZURE_SDK_CLIENT_USER_AGENT "c%2F" AZ_SDK_VERSION_STRING "(ard;esp8266)"

#define sizeofarray(a) (sizeof(a) / sizeof(a[0]))
#define ONE_HOUR_IN_SECS 3600
#define NTP_SERVERS "pool.ntp.org", "time.nist.gov"
#define MQTT_PACKET_SIZE 1024
#define TELEMETRY_FREQUENCY_MILLISECS 2000

unsigned char ca_pem[] PROGMEM = {
  0x2d, 0x2d, 0x2d, 0x2d, 0x2d, 0x42, 0x45, 0x47, 0x49, 0x4e, 0x20, 0x43,
  0x45, 0x52, 0x54, 0x49, 0x46, 0x49, 0x43, 0x41, 0x54, 0x45, 0x2d, 0x2d,
  0x2d, 0x2d, 0x2d, 0x0a, 0x4d, 0x49, 0x49, 0x44, 0x64, 0x7a, 0x43, 0x43,
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  0x46, 0x49, 0x43, 0x41, 0x54, 0x45, 0x2d, 0x2d, 0x2d, 0x2d, 0x2d, 0x0a,
  0x00
};

static String ssid = "";
static String password = "";
static String device_id = "";
static String device_key = "";
static const char* host = "drone-trainer-iot-hub.azure-devices.net";
static const int port = 8883;

String configString = "";

static WiFiClientSecure wifi_client;
static X509List cert((const char*)ca_pem);
static PubSubClient mqtt_client(wifi_client);
static az_iot_hub_client client;
MFRC522 rfid(15, 9);
static char sas_token[200];
static uint8_t signature[512];
static unsigned char encrypted_signature[32];
static char base64_decoded_device_key[32];
static unsigned long next_telemetry_send_time_ms = 0;
static char telemetry_topic[128];
static uint8_t telemetry_payload[100];
static uint32_t telemetry_send_count = 0;

bool is_session_started = false;
bool is_attempt_started = false;
std::vector<long> gate_pass_results(0);
String locale = "";
int current_attempt_id = 0;
int current_session_id = 0;
time_t current_attempt_start_time;
bool attempt_pass_read = false;

static void connectToWiFi()
{
  Serial.println();
  Serial.print("Connecting to WIFI SSID ");
  Serial.println(ssid);

  WiFi.mode(WIFI_STA);
  WiFi.disconnect();
  delay(100);
  WiFi.begin(ssid, password);
  while (WiFi.status() != WL_CONNECTED)
  {
    delay(500);
    Serial.print(".");
  }

  Serial.print("WiFi connected, IP address: ");
  Serial.println(WiFi.localIP());
}

static void initializeTime()
{
  Serial.print("Setting time using SNTP");

  configTime(-5 * 3600, 0, NTP_SERVERS);
  time_t now = time(NULL);
  while (now < 1510592825)
  {
    delay(500);
    Serial.print(".");
    now = time(NULL);
  }
  Serial.println("done!");
}

static char* getCurrentLocalTimeString()
{
  time_t now = time(NULL);
  return ctime(&now);
}

static void printCurrentTime()
{
  Serial.print("Current time: ");
  Serial.print(getCurrentLocalTimeString());
}

void receivedCallback(char* topic, byte* payload, unsigned int length)
{
  String message = "";

  for (int i = 0; i < length; i++)
  {
    message += (char)payload[i];
  }

  Serial.println(message);

  StaticJsonDocument<256> doc;
  DeserializationError error = deserializeJson(doc, message);
  if (error) {
    Serial.print("Config parsing failed: ");
    Serial.println(error.c_str());
  } else {
    handle_cloud_to_device_message(doc);
  }
}

void handle_cloud_to_device_message(ArduinoJson::JsonDocument & message) {
  if(message["message_type"] == "session_start") {
    handle_session_start(message);
    return;
  }

  if(message["message_type"] == "session_end") {
    handle_session_end();
    return;
  }

  if(message["message_type"] == "attempt_start") {
    handle_attempt_start(message);
    return;
  }

  if(message["message_type"] == "attempt_end") {
    handle_attempt_end();
    return;
  }
}

void handle_session_start(ArduinoJson::JsonDocument & message) {
  Serial.println("session started");
  is_session_started = true;

  locale = (String)message["locale"];
  current_session_id = ((String)message["session_id"]).toInt();
}

void handle_session_end() {
  if(!is_session_started) {
    Serial.println("Session is not started");
    return;
  }

  Serial.println("session ended");

  double step_avarage_time = 0;

  Serial.println(gate_pass_results.size());

  for(int i = 0; i < gate_pass_results.size(); i++){
    Serial.println(gate_pass_results[i]);
    double attempt_avarage = gate_pass_results[i] / (double)gate_pass_results.size();
    step_avarage_time += attempt_avarage;
  }

  is_session_started = false;
  gate_pass_results.clear();
  Serial.println(step_avarage_time);
  String message = "{\"message_type\": \"session_result\", \"session_id\": " + String(current_session_id)
    + ", \"device_id\" : \"" + String(device_id) + "\", \"avarage_time_in_seconds\": "+ String(step_avarage_time) +" }";

  sendTelemetry(message.c_str());
}

void handle_attempt_start(ArduinoJson::JsonDocument & message) {
  if(!is_session_started) {
    Serial.println("Session is not started");
    return;
  }

  Serial.println("attempt started");
  Serial.println((String)message["started_at"]);

  is_attempt_started = true;
  attempt_pass_read = false;
  current_attempt_id = ((String)message["attempt_id"]).toInt();

  struct tm tmStruct;
  strptime(((String)message["started_at"]).c_str(), "%Y-%m-%dT%H:%M:%S", &tmStruct);

  current_attempt_start_time = mktime(&tmStruct);
}

void handle_attempt_end() {
  if(!is_attempt_started) {
    Serial.println("Session is not started");
    return;
  }

  Serial.println("attempt ended");
  is_attempt_started = false;
}

void handle_step_pass(){
  time_t passed_at = time(0);
  char formatted_pass_time[50];

  long diff = difftime(current_attempt_start_time, passed_at);
  gate_pass_results.push_back(diff);

  if(locale == "en-US"){
    strftime(formatted_pass_time, sizeof(formatted_pass_time), "%F %r", gmtime(&passed_at));
  } else {
    strftime(formatted_pass_time, sizeof(formatted_pass_time), "%F %T", gmtime(&passed_at));
  }

  String message = "{\"message_type\": \"step_pass\", \"locale\": \"" + locale + "\", \"attempt_id\":" + String(current_attempt_id) + ", \"device_id\": \"" + device_id + "\", \"passed_at\": \"" + formatted_pass_time + "\"}";

  sendTelemetry(message.c_str());
}

static void initializeClients()
{
  az_iot_hub_client_options options = az_iot_hub_client_options_default();
  options.user_agent = AZ_SPAN_FROM_STR(AZURE_SDK_CLIENT_USER_AGENT);

  wifi_client.setTrustAnchors(&cert);
  if (az_result_failed(az_iot_hub_client_init(
          &client,
          az_span_create((uint8_t*)host, strlen(host)),
          az_span_create((uint8_t*)device_id.c_str(), strlen(device_id.c_str())),
          &options)))
  {
    Serial.println("Failed initializing Azure IoT Hub client");
    return;
  }

  mqtt_client.setServer(host, port);
  mqtt_client.setCallback(receivedCallback);
}

static uint32_t getSecondsSinceEpoch() { return (uint32_t)time(NULL); }

static int generateSasToken(char* sas_token, size_t size)
{
  az_span signature_span = az_span_create((uint8_t*)signature, sizeofarray(signature));
  az_span out_signature_span;
  az_span encrypted_signature_span
      = az_span_create((uint8_t*)encrypted_signature, sizeofarray(encrypted_signature));

  uint32_t expiration = getSecondsSinceEpoch() + ONE_HOUR_IN_SECS;

  if (az_result_failed(az_iot_hub_client_sas_get_signature(
          &client, expiration, signature_span, &out_signature_span)))
  {
    Serial.println("Failed getting SAS signature");
    return 1;
  }

  int base64_decoded_device_key_length
      = base64_decode_chars(device_key.c_str(), strlen(device_key.c_str()), base64_decoded_device_key);

  if (base64_decoded_device_key_length == 0)
  {
    Serial.println("Failed base64 decoding device key");
    return 1;
  }

  br_hmac_key_context kc;
  br_hmac_key_init(
      &kc, &br_sha256_vtable, base64_decoded_device_key, base64_decoded_device_key_length);

  br_hmac_context hmac_ctx;
  br_hmac_init(&hmac_ctx, &kc, 32);
  br_hmac_update(&hmac_ctx, az_span_ptr(out_signature_span), az_span_size(out_signature_span));
  br_hmac_out(&hmac_ctx, encrypted_signature);

  String b64enc_hmacsha256_signature = base64::encode(encrypted_signature, br_hmac_size(&hmac_ctx));

  az_span b64enc_hmacsha256_signature_span = az_span_create(
      (uint8_t*)b64enc_hmacsha256_signature.c_str(), b64enc_hmacsha256_signature.length());

  if (az_result_failed(az_iot_hub_client_sas_get_password(
          &client,
          expiration,
          b64enc_hmacsha256_signature_span,
          AZ_SPAN_EMPTY,
          sas_token,
          size,
          NULL)))
  {
    Serial.println("Failed getting SAS token");
    return 1;
  }

  return 0;
}

static int connectToAzureIoTHub()
{
  size_t client_id_length;
  char mqtt_client_id[128];
  if (az_result_failed(az_iot_hub_client_get_client_id(
          &client, mqtt_client_id, sizeof(mqtt_client_id) - 1, &client_id_length)))
  {
    Serial.println("Failed getting client id");
    return 1;
  }

  mqtt_client_id[client_id_length] = '\0';

  char mqtt_username[128];

  if (az_result_failed(az_iot_hub_client_get_user_name(
          &client, mqtt_username, sizeofarray(mqtt_username), NULL)))
  {
    printf("Failed to get MQTT clientId, return code\n");
    return 1;
  }

  Serial.print("Client ID: ");
  Serial.println(mqtt_client_id);

  Serial.print("Username: ");
  Serial.println(mqtt_username);

  mqtt_client.setBufferSize(MQTT_PACKET_SIZE);

  int retryCount = 0;

  while (!mqtt_client.connected() && retryCount < 5)
  {
    time_t now = time(NULL);

    Serial.print("MQTT connecting ... ");

    if (mqtt_client.connect(mqtt_client_id, mqtt_username, sas_token))
    {
      Serial.println("connected.");
    }
    else
    {
      Serial.print("failed, status code =");
      Serial.print(mqtt_client.state());
      Serial.println(". Trying again in 5 seconds.");

      retryCount++;
      delay(5000);
    }
  }

  mqtt_client.subscribe(AZ_IOT_HUB_CLIENT_C2D_SUBSCRIBE_TOPIC);

  return 0;
}

static void establishConnection()
{
  connectToWiFi();
  initializeTime();
  printCurrentTime();
  initializeClients();

  if (generateSasToken(sas_token, sizeofarray(sas_token)) != 0)
  {
    Serial.println("Failed generating MQTT password");
  }
  else
  {
    connectToAzureIoTHub();
  }
}

static char* getTelemetryPayload()
{
  az_span temp_span = az_span_create(telemetry_payload, sizeof(telemetry_payload));
  temp_span = az_span_copy(temp_span, AZ_SPAN_FROM_STR("{ \"msgCount\": "));
  (void)az_span_u32toa(temp_span, telemetry_send_count++, &temp_span);
  temp_span = az_span_copy(temp_span, AZ_SPAN_FROM_STR(" }"));
  temp_span = az_span_copy_u8(temp_span, '\0');

  return (char*)telemetry_payload;
}

static void sendTelemetry(const char* payload)
{
  Serial.print(millis());
  Serial.print(" ESP8266 Sending telemetry . . . ");
  if (az_result_failed(az_iot_hub_client_telemetry_get_publish_topic(
          &client, NULL, telemetry_topic, sizeof(telemetry_topic), NULL)))
  {
    Serial.println("Failed az_iot_hub_client_telemetry_get_publish_topic");
    return;
  }

  mqtt_client.publish(telemetry_topic, payload, false);
  Serial.println("OK");
  delay(100);
}


void setup()
{
  Serial.begin(9600);
  Serial.println(ESP.getFreeHeap());
  loadDeviceConfiguration();
  Serial.println(ESP.getFreeHeap());
  delay(5000);
  establishConnection();
  delay(5000);
  SPI.begin();
  delay(1000);
  rfid.PCD_Init();
}

void loop()
{
  configString = Serial.readStringUntil('\n');
  Serial.print("New config: ");
  Serial.println(configString);
  StaticJsonDocument<256> doc;
  DeserializationError error = deserializeJson(doc, configString);

  if (error) {
    Serial.print("Config parsing failed: ");
    Serial.println(error.c_str());
  } else {
    setDeviceConfiguration(doc);
    Serial.println("New configuration was set. Restarting...");
    ESP.restart();
  }

  configString = "";

  if (!mqtt_client.connected())
  {
    establishConnection();
  } else {
    if(is_attempt_started && !attempt_pass_read){
      String read_result = read_step();
      if(read_result != ""){
        handle_step_pass();
      }
    }

    mqtt_client.loop();
    delay(3000);
  }
}

String readFromMemory(int start, int end){
  String data = "";
  for (int i = start; i < end; ++i) {
    char readChar = char(EEPROM.read(i));
    if (readChar == 0) {
      break;
    }

    data += readChar;
  }

  return data;
}

void writeToMemory(int start, String data){
  Serial.println("Writing to memory:");

  for (int i = 0; i < data.length(); i++)
  {
    EEPROM.write(start + i, data[i]);
    Serial.print("Wrote: ");
    Serial.println(data[i]);
  }
}

void setDeviceConfiguration(ArduinoJson::JsonDocument & doc) {
  EEPROM.begin(512);
  for (int i = 0; i < 160; i++) {
    EEPROM.write(i, 0);
  }

  writeToMemory(0, doc["SSID"]);
  writeToMemory(32, doc["Password"]);
  writeToMemory(64, doc["PrimaryKey"]);
  writeToMemory(128, doc["UniqueId"]);

  EEPROM.commit();
  EEPROM.end();
}

void loadDeviceConfiguration(){
  EEPROM.begin(512);

  ssid = readFromMemory(0, 32);
  Serial.println(ssid);
  password = readFromMemory(32, 64);
  Serial.println(password);
  device_key = readFromMemory(64, 128);
  Serial.println(device_key);
  device_id = readFromMemory(128, 160);
  Serial.println(device_id);

  EEPROM.end();
}

String read_step() {
  String tag = readRFID();
  if (tag == "") {
    return "";
  }

  Serial.println(tag);
  attempt_pass_read = true;
  return tag;
}

String readRFID() {
  if (!rfid.PICC_IsNewCardPresent()) {
    Serial.println("No card");
    return "";
  }

  if (!rfid.PICC_ReadCardSerial()) {
    Serial.println("Nothing to read");
    return "";
  }

  String tag = "";
  for (int i = 0; i < rfid.uid.size; i++) {
    tag += rfid.uid.uidByte[i];
  }

  rfid.PICC_HaltA();
  rfid.PCD_StopCrypto1();

  return tag;
}